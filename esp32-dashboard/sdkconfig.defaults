## esp32-dashboard/sdkconfig.defaults
```kconfig
# ----------------------------------------------------------------
# Target: ESP32-S3
# Board:  Waveshare ESP32-S3-Touch-LCD-4.3B  (800x480, GT911, RGB)
# ----------------------------------------------------------------

CONFIG_IDF_TARGET="esp32s3"

# CPU / clock
CONFIG_ESP32S3_DEFAULT_CPU_FREQ_240=y

# PSRAM (OPI PSRAM on Waveshare board)
CONFIG_SPIRAM=y
CONFIG_SPIRAM_MODE_OCT=y
CONFIG_SPIRAM_SPEED_80M=y
CONFIG_SPIRAM_BOOT_INIT=y
CONFIG_SPIRAM_USE_MALLOC=y
CONFIG_SPIRAM_MALLOC_ALWAYSINTERNAL=16384

# Flash
CONFIG_ESPTOOLPY_FLASHSIZE_16MB=y
CONFIG_PARTITION_TABLE_CUSTOM=y
CONFIG_PARTITION_TABLE_CUSTOM_FILENAME="partitions.csv"

# FreeRTOS — run LVGL on core 1, MEMS task on core 0
CONFIG_FREERTOS_UNICORE=n
CONFIG_ESP_MAIN_TASK_AFFINITY_CPU0=y

# UART (MEMS diagnostic cable)
CONFIG_MINI_MEMS_UART_PORT=1
CONFIG_MINI_MEMS_UART_BAUD=9600
CONFIG_MINI_MEMS_UART_TX_PIN=17
CONFIG_MINI_MEMS_UART_RX_PIN=18

# Logging
CONFIG_LOG_DEFAULT_LEVEL_INFO=y

# LVGL (managed component lvgl/lvgl)
CONFIG_LV_CONF_SKIP=n
CONFIG_LV_COLOR_DEPTH_16=y
CONFIG_LV_HOR_RES_MAX=800
CONFIG_LV_VER_RES_MAX=480
CONFIG_LV_DPI_DEF=130
CONFIG_LV_DISP_DEF_REFR_PERIOD=16
CONFIG_LV_MEM_CUSTOM=y
CONFIG_LV_MEM_SIZE_KILOBYTES=512
CONFIG_LV_USE_PERF_MONITOR=n
CONFIG_LV_USE_LOG=y
CONFIG_LV_LOG_LEVEL_WARN=y
CONFIG_LV_USE_ARC=y
CONFIG_LV_USE_LABEL=y
CONFIG_LV_USE_LINE=y
CONFIG_LV_USE_IMG=y
CONFIG_LV_USE_CHART=y
CONFIG_LV_USE_MSGBOX=y
CONFIG_LV_USE_SPINNER=y
CONFIG_LV_FONT_MONTSERRAT_14=y
CONFIG_LV_FONT_MONTSERRAT_20=y
CONFIG_LV_FONT_MONTSERRAT_28=y
CONFIG_LV_FONT_MONTSERRAT_48=y
```
